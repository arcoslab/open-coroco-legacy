#define F_CPU 10000000UL
#include <avr/io.h>
#include <util/delay.h>
#include <stdio.h>
#include "UART.h"
#include "Hardware.h"
#include "Timer.h"
#include <avr/interrupt.h>
#include <avr/pgmspace.h>
#include <math.h>

#define sinTableSize  3600
PROGMEM prog_int16_t sin_table[sinTableSize]= { 0 , 0 , 1 , 2 , 3 , 4 , 5 , 6 , 7 , 8 , 8 , 9 , 10 ,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 -1 , 0 };
//PROGMEM prog_int16_t prueba[2]={0x10,0x11};

#define PORTC_ON( pin )		PORTC|= (1 << pin );
#define PORTC_OFF( pin )    	PORTC&= (~(1 << pin )); 

#define maxValPWM 0x1ff
//#define maxValPWM 0x0ff
//#define Kv 900 //motor sky
#define Kv 62.5
//#define Kv 416
//#define maxFreq 570 //motor sky
#define maxFreq 39.68
//#define maxFreq 50
//#define P 0.1
#define Tc 0.000064*2
//#define Tc 0.000064*4
//#define maxFreq 264
//This speed is for 12.7Volts: Formula: Poles*Kv*V/60. Poles=3, Kv=900
#define phaseConst 40
#define closeInitFreq 80
#define closeFinalFreq 30
#define fspinError 4
#define TimerResFactor 1
#define maxPhaseAdvance 90*phaseConst
#define maxA maxPhaseAdvance/72
int T=20000;
int dT=50;
int closeLoop=0;
int phaseRotor=0;
int phaseStator=0;
int phaseAdvance=0;
int Terror=0;
int phaseSum=0;
int phaseStatorPointerA=340;
int phaseStatorPointerB=340-120;
int phaseStatorPointerC=340-240;;
double freq=0;
double phase=0; //in rads
int A=0;
int dutyA;
int dutyB;
int dutyC;

ISR(TIMER2_COMP_vect) {
  //We enter this routine with a frequency of 3968Hz
  //One count is 0.000252s
  static int dutyAT=0;
  static int dutyBT=0;
  static int dutyCT=0;
  static int time=-1;
  static int Ttemp=0;
  time+=1;
  PORTC_ON( PINC0 )
  PORTC_ON( PINC1 )
  
  //Dealing with slow rotor problem
  Ttemp+=1;
  if ((Ttemp*2>T) && closeLoop) { //if no more readings from the halls sensors then update T
    T=Ttemp*2;
  }

  //Rotor and Stator phase calculations
  phaseStator=phaseStator+360*phaseConst/T;
  phaseRotor=phaseRotor+360*phaseConst/T;

  PORTC_OFF( PINC1 )

  //code for hall sensoring
  static int hall1Rise=0;
  static int hall1Old=-20000;
  static int hall1tOld=-30000; //To produce a small initial frequency
  int hall1;
  int hallUpdate=0;
  static int hallUpdateRise=0;
  static int hallUpdateFall=0;
  hall1=(int) ADC;
  if (hall1 > hall1Old) {
    hall1Rise=1;
  } 
  if (hall1 < hall1Old) {
    hall1Rise=0;
  }
  if ((hall1Rise==1) && (hall1>0) && (hallUpdateRise==0)) {
    PORTC_ON( PINC2 )
    //zero crossing rising
    //Fix phase to zero
    //Calculate new frequency
    if (closeLoop==1) {
      T=(time-hall1tOld)*2; //Half a cycle
    }
    hall1tOld=time;
    phaseRotor=0;
    hallUpdate=1;
    hallUpdateRise=1;
    hallUpdateFall=0;
    //PORTC_OFF( PINC2 )
  }
  if ((hall1Rise==0) && (hall1<0) && (hallUpdateFall==0)) {
    //PORTC_ON( PINC2 )
    //zero crossing falling
    //Fix phase to 180
    //Calculate new frequency
    if (closeLoop==1) {
      T=(time-hall1tOld)*2; //Half a cycle
    }
    hall1tOld=time;
    phaseRotor=180*phaseConst;
    hallUpdate=1;
    hallUpdateFall=1;
    hallUpdateRise=0;
    PORTC_OFF( PINC2 )
  }
  int phaseU;
  int phaseExcess;
  if (hallUpdate==1) {
    Ttemp=0;
    //PI controllers over phaseAdvance and Voltage
    //Controlling with phaseAdvance. Can not control with amplitud because it can not go negative (It probably can but is not that intuitive)
    //Voltage proportionally "attached" to phaseAdvance.
    //When voltage is maximum, phaseAdvance is 90 and the desired speed is over the maximum with this configuration
    //It allows phaseAdvance to be bigger than 90 (max 180) to allow get the max speed possible
    
    #define Pkp 3 //8-12 works fine for a look of 2Khz, 3 for a loop of 8KHz
    #define PkpHighAdvance 1 // For Advances bigger than 90 degrees. 1 works ok for a look of ~8KHz
    //#define Pki 1 //1 works fine
    static short int Pki=1;
    #define Pkc 1 //1 works fine
    if (closeLoop==1) {
      Terror=-(dT-T);
        phaseU=Terror*Pkp+phaseSum;
        if ((A<maxA) || ((dT<23*4) && (T>28*4)) || (dT>24*4)) {
          Pki=1;
          if (phaseU>maxPhaseAdvance) {
            phaseAdvance=maxPhaseAdvance;
            A=maxA;
          } else {
            if (phaseU<-maxPhaseAdvance) {
              phaseAdvance=-maxPhaseAdvance;
              A=maxA;
            } else {
                phaseAdvance=phaseU;
                //Amplitud proportional to phaseAdvance
                if (phaseAdvance<0) {
                  A=-phaseAdvance/72;
                } else {
                  A=phaseAdvance/72;
                }
            }
          }
        } else {
          Pki=8;
          A=maxA;
          if (phaseU>maxPhaseAdvance*2) {
            phaseAdvance=maxPhaseAdvance*2;
          } else {
            if (phaseU<-maxPhaseAdvance*2) {
              phaseAdvance=-maxPhaseAdvance*2;
            } else {
                //phaseU=Terror*PkpHighAdvance+phaseSum;
                phaseAdvance=phaseU;
            }
          }
        }
      phaseExcess=phaseU-phaseAdvance;
      phaseSum+=Terror/Pki-Pkc*phaseExcess;

      if (A>maxA) {
          A=maxA;
      }
    }
  }
  hall1Old=hall1;

  //update phaseStator
  if (closeLoop==1) {
      phaseStator=phaseRotor+phaseAdvance;
  } else {
    phaseRotor=phaseStator;
  }
  
  //Mantain this numbers controlled
  while (phaseStator>=360*phaseConst) {
    phaseStator=phaseStator-360*phaseConst;
    phaseRotor=phaseRotor-360*phaseConst;
  }
  
  //Get addressing for the sin table
  phaseStatorPointerA=phaseStator/4;
  while (phaseStatorPointerA<0) {
    phaseStatorPointerA=phaseStatorPointerA+sinTableSize;
  }
  phaseStatorPointerB=phaseStatorPointerA-120*10;
  if (phaseStatorPointerB<0) {
    phaseStatorPointerB=phaseStatorPointerB+sinTableSize;
  }
  phaseStatorPointerC=phaseStatorPointerB-120*10;
  if (phaseStatorPointerC<0) {
    phaseStatorPointerC=phaseStatorPointerC+sinTableSize;
  }
  int angleSinA_i=pgm_read_word(sin_table+phaseStatorPointerA);
  int angleSinB_i=pgm_read_word(sin_table+phaseStatorPointerB);
  int angleSinC_i=pgm_read_word(sin_table+phaseStatorPointerC);
  
  PORTC_ON( PINC1 )
  dutyAT=(A*angleSinA_i)/50;
  dutyBT=(A*angleSinB_i)/50;
  dutyCT=(A*angleSinC_i)/50;
  PORTC_OFF( PINC1 )
/*  dutyA=(int) ((A*((signed long int) (angleSinA_i))/(maxA*TimerResFactor)));
  dutyB=(int) ((A*((signed long int) (angleSinB_i))/(maxA*TimerResFactor)));
  dutyC=(int) ((A*((signed long int) (angleSinC_i))/(maxA*TimerResFactor)));*/
//  dutyA=A*maxValPWM*sin((2*M_PI/(360*phaseConst))*((double) phaseStator));
//  dutyB=A*maxValPWM*sin((2*M_PI/(360*phaseConst))*((double) phaseStator)-2.0*M_PI/3.0);
//  dutyC=A*maxValPWM*sin((2*M_PI/(360*phaseConst))*((double) phaseStator)-4.0*M_PI/3.0);
  
  cli();
  dutyA=dutyAT;
  dutyB=dutyBT;
  dutyC=dutyCT;
  sei();
  
  PORTC_OFF( PINC0 )
  
}

ISR(SIG_OVERFLOW1) {
  
  if (dutyA<0) {
    OCR1A=0;
    OCR3A=-dutyA;
  } else {
    OCR1A = dutyA;
    OCR3A =0;    
  }
  if (dutyB<0) {
    OCR1B=0;
    OCR3B=-dutyB;
  } else {
    OCR1B = dutyB;
    OCR3B = 0;
  }
  if (dutyC<0) {
    OCR1C=0;
    OCR3C=-dutyC;
  } else {
    OCR1C = dutyC;
    OCR3C = 0;
  }
  
}


void delayms(uint16_t millis) {
  //uint16_t loop;
  while ( millis ) {
    _delay_ms(1);
    millis--;
  }
}

int main(void) {
  //int i;
  FILE *u0;
  double error;
  double dfreq=0;
  double tfreq;
  double P=0.1;
  int spinning=0;
  
  InitHardware();
  
#if defined( __AVR_LIBC_VERSION__ )
  u0 = fdevopen( UART0_PutCharStdio, UART0_GetCharStdio );
#else  
  u0 = fdevopen( UART0_PutCharStdio, UART0_GetCharStdio, 0 );
#endif
  OCR1A = 0x00;
  OCR1B = 0;
  OCR1C = 0;
  OCR3A = 0;
  OCR3B= 0 ;
  OCR3C=0;
  timer13Start();
  ADCSR |= (1 << ADFR);
  ADMUX |= (1 << ADLAR);
  ADCSR |= (1 << ADSC);
  ADMUX |= (1 << MUX4);
  //ADCSR=0xC7;
  //ADCSR=0xE7;
  //ADMUX=0x00;
  
  //DDRC|= (1 << DDC0);
  //DDRC|= (1 << DDC1);
  DDRC=0xFF;
  PORTC_OFF( PINC0 )
  TIMSK = TIMSK | (1<<TOIE1) | (1<<OCIE2); //Enabling interrupts
  
  while(1) {
    LED_ON( BLUE );
    LED_OFF( RED );
    //printf("Led Blue On \n");
    delayms(5);
    LED_OFF( BLUE );
    LED_ON( RED );
    //printf("Led Blue OFF \n");
    //TCNT1=0;
    /*
    printf("Timer value: %04x ", TCNT1);
    printf("Duty Cycle: %d \n", dutyA);
    printf("ADC0 input: %d\n", (int) ADC);
    */
    //printf("ADCSR: %04x \n", ADCSR);
    //printf("Control Registers 1: %02x 2: %02x 3: %02x\n", TCCR1A, TCCR1B, TCCR1C);
    //printf("XVID crystal divider %02x\n",XDIV);
    
    
    
    /*for ( i = 0; i < 100; i++ ) 
    {
      WaitForTimer0Rollover();
    }*/
    
     
    if ( UART0_IsCharAvailable() )
    {
                char    ch = getchar();

                //printf( "Read: '%c'\n", ch );

                if ( ch == ' ' )
                {
                    /*
                    printf( "*** Set the new frequency\n" );
                    //ch = getchar();
                    int rfreq;
                    scanf("%d",&rfreq);
                    printf( "*** Received %d. Continuing...\n",rfreq );
                    if (rfreq==0) {
                      freq=0;
                      printf( "*** Set the phase\n");
                      int rphase;
                      scanf("%d",&rphase);
                      printf( "*** Received %d. Continuing...\n",rphase);
                      dphase=rphase*2*M_PI/360;
                    }
                    //dfreq=rfreq;
                    A=((double) rfreq)/100;
                    //freq=dfreq;
                    //A=freq/maxFreq;
                    //printf("Setting Amplitud to: %d \n",(int) (100*A));
                    */
                    /*
                    printf( "*** Set the new Amplitud\n" );
                    //ch = getchar();
                    int rA;
                    scanf("%d",&rA);
                    printf( "*** Set the new Phase advance\n" );
                    //ch = getchar();
                    int rPhaseAdvance;
                    scanf("%d",&rPhaseAdvance);
                    printf( "*** Received %d %d. Continuing...\n",rA, rPhaseAdvance );
                    //dfreq=rfreq;
                    A=maxValPWM*((unsigned int) rA)/100;
                    phaseAdvance=rPhaseAdvance*phaseConst;
                    //freq=dfreq;
                    //A=freq/maxFreq;
                    //printf("Setting Amplitud to: %d \n",(int) (100*A));
                    */
                    
                    //printf( "*** Set the new frequency\n" );
                    //ch = getchar();
                    int rfreq;
                    scanf("%d",&rfreq);
                    //printf( "*** Received %d. Continuing...\n",rfreq );
                    dT=(int) ((1.0/((double) (rfreq)))/((double) (Tc)));
                    
                    //printf("Setting Amplitud to: %d \n",(int) (100*A));
                }
    }
    if (closeLoop==0) {
      //printf("Open Loop!\n");
      closeLoop=0;
      spinning=0;
      A=maxA-(maxA/8); //80%
      dfreq=20;
      P=0.2;
      error=dfreq-freq;
      if (error>8.0) {
        error=8.0;
      }
      if (error<-8.0) {
        error=-8.0;
      }
      tfreq=freq+P*error;
      freq=tfreq;
      T=1/(freq*Tc);
      //printf("Period: %d\n", T);
      if (freq>10) {
        //A=maxValPWM;
        //phaseAdvance=90*phaseConst;
        phaseSum=90*phaseConst;
        dT=(int) ((1.0/closeInitFreq)/((double) (Tc))); //50Hz initial freq
        closeLoop=1;
        spinning=1;
      }
    } else {
      if (spinning==1) {
        dfreq=(int) (1/(((double) dT)*Tc));
        freq=(int) (1/(((double) T)*Tc));
        
        if (((dfreq-freq)<fspinError) && ((dfreq-freq)>-fspinError) ) {
          //We have got to the Close loop initial frequency, now going to the final freq
          dT=(int) ((1.0/closeFinalFreq)/((double) (Tc))); //50Hz initial freq
          spinning=0;
        }
      }
      //printf("Close loop!\n");
      if ((1/(T*Tc)<1) && (1/(T*Tc)>-1)) {
        closeLoop=0;
        freq=1/(T*Tc);
      }
    }
    //A=tfreq/maxFreq;
    //if (A<0.6) {
    //  A=0.6;
    //}
    //if (freq>maxFreq) {
    //  A=1.0;
    //}
    int pphaseStator=phaseStator;
    int pphaseRotor=phaseRotor;
    int pTerror=Terror;
    int pdT=dT;
    int pT=T;
    int pphaseAdvance=phaseAdvance;
    int pA=A;
    
    printf("Set_Speed: %d Speed: %d Terror: %d phaseAdvance: %d Amplitud: %d Stator_phase: %d Rotor_phase: %d\n", (int) (10/(((double) pdT)*Tc)) ,(int) (10/(((double ) pT)*Tc)), pTerror, pphaseAdvance/40, pA, pphaseStator/40, pphaseRotor/40);
/*    printf("Frequency: %d , Dest Freq: %d \n",(int) (1/(((double ) T)*Tc)), (int) (1/(((double) dT)*Tc)));
    printf("Phase Stator: %d Phase Rotor: %d\n", pphaseStator, pphaseRotor);
    printf("Period (in ticks) : %d Destination Period(in ticks): %d\n", T, dT );
    printf("Terror: %d phaseAdvance: %d Amplitud: %d\n", pTerror, phaseAdvance/phaseConst, A/36);
    static int pruebaPointer=0;
    printf("Test flash mem: %d\n", pgm_read_word(sin_table+pruebaPointer));
    pruebaPointer+=1;
    if (pruebaPointer==sinTableSize) {
      pruebaPointer=0;
    }*/
/*    int  pphaseStatorPointerA;
    pphaseStatorPointerA=phaseStatorPointerA;
    double pA=A;
    int ppptemp=pgm_read_word(sin_table+pphaseStatorPointerA);
    double pppDoubletemp=pgm_read_word(sin_table+pphaseStatorPointerA);
    
    printf("PhaseStator Pointer: %d, Sin %d, PWM: %d\n", pphaseStatorPointerA, pgm_read_word(sin_table+pphaseStatorPointerA), ((int) (pA*((double) (ppptemp)))) );
*/  //  printf("========================================\n");
    //delayms(500);
  }
  return 0;
}
